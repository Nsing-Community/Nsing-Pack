# N32G41x register map
Vendor: Nsingtech Ltd.; File version: 1.0
CPU: CM4 r0p1, little endian, no MPU, no FPU, 4 interrupt priority bits
Registers are 32-bit, read-write, reset 0x0 unless marked. A register's access mark holds for its fields unless they carry their own. Offsets are from the block's base; lines under a group give offsets from that group; [hi:lo] are bit positions; {n}, {i} and the like mark numbered series; 'fields as' and 'values as' point back to an identical list; <NAME> marks a mode.

## Memory map
0x40000000 GTIM1 size 0x400 — General-purpose Timer 1
0x40000400 GTIM2 size 0x400 — General-purpose Timer 2
0x40000800 GTIM3 size 0x400 — General-purpose Timer 3
0x40000C00 GTIM4 size 0x400
0x40001000 BTIM1 size 0x400 — Basic Timer 1
0x40001400 BTIM2 size 0x400
0x40002000 OPAMP size 0x400 — Operational Amplifier
0x40002400 COMP size 0x400 — Comparator
0x40002800 RTC size 0x400 — Real-Time Clock
0x40002C00 WWDG size 0x400 — Window Watchdog
0x40003000 IWDG size 0x400 — Independent Watchdog
0x40004400 USART2 size 0x400
0x40004800 USART3 size 0x400
0x40005400 I2C1 size 0x400 — Inter-Integrated Circuit
0x40005800 I2C2 size 0x400
0x40006400 CAN size 0x400 — Controller Area Network
0x40007000 PWR size 0x400 — Power Control
0x40010400 EXTI size 0x400 — External Interrupt/Event Controller
0x40012C00 ATIM1 size 0x400 — Advanced Timer 1
0x40013000 SPI1_I2S size 0x400 — Serial Peripheral Interface 1
0x40013400 ATIM2 size 0x400 — Advanced Timer 2
0x40013800 USART1 size 0x400 — Universal Synchronous Asynchronous Receiver Transmitter
0x40013C00 SPI2 size 0x400 — Serial Peripheral Interface 2
0x40015000 USART4 size 0x400
0x40020000 DMA size 0x400 — Direct Memory Access Controller
0x40020800 ADC1 size 0x100 — Analog-to-digital converter
0x40020900 ADC2 size 0x100
0x40021000 RCC size 0x400 — Reset and Clock Control
0x40021400 GPIOA size 0x100 — GPIO Port A
0x40021500 GPIOB size 0x100 — GPIO Port B
0x40021600 GPIOC size 0x100 — GPIO Port C
0x40021700 GPIOD size 0x100 — GPIO Port D
0x40021800 AFIO size 0x400 — Alternate Function I/O
0x40022000 FLASH size 0x400 — FLASH Memory Controller
0x40023000 CRC size 0x400 — CRC Calculation Unit
0xE0042000 DBG size 0x400 — Debug Support

## Interrupts
0 WWDG — WWDG global interrupt
1 PVD (PWR) — PVD interrupt through EXTI line 16
2 RTC_STAMP_LSECSS (RTC) — RTC timestamp and LSE CSS interrupt
3 RTC_WKUP (RTC) — RTC wakeup interrupt
4 FLASH — FLASH global interrupt
5 RCC — RCC global interrupt
6 EXTI0 (EXTI) — EXTI Line 0 interrupt
7 EXTI1 (EXTI) — EXTI Line 1 interrupt
8 EXTI2 (EXTI) — EXTI Line 2 interrupt
9 EXTI3 (EXTI) — EXTI Line 3 interrupt
10 EXTI4 (EXTI) — EXTI Line 4 interrupt
11 DMA_CH1 (DMA) — DMA Channel 1 global interrupt
12 DMA_CH2 (DMA) — DMA Channel 2 global interrupt
13 DMA_CH3 (DMA) — DMA Channel 3 global interrupt
14 DMA_CH4 (DMA) — DMA Channel 4 global interrupt
15 DMA_CH5 (DMA) — DMA Channel 5 global interrupt
16 DMA_CH6 (DMA) — DMA Channel 6 global interrupt
17 DMA_CH7 (DMA) — DMA Channel 7 global interrupt
18 ADC2 — ADC2 global interrupt
19 ADC1 — ADC1 global interrupt
20 BTIM1 — BTIM1 global interrupt
21 BTIM2 — BTIM2 global interrupt
22 COMP1_2_3 (COMP) — COMP1/2/3 global interrupt
23 EXTI9_5 (EXTI) — EXTI Line 9 to 5 interrupt
24 ATIM1_BRK (ATIM1) — ATIM1 break interrupt
25 ATIM1_UP (ATIM1) — ATIM1 update interrupt
26 ATIM1_TRG_COM (ATIM1) — ATIM1 trigger and commutation interrupt
27 ATIM1_CC (ATIM1) — ATIM1 capture compare interrupt
28 GTIM1 — GTIM1 global interrupt
29 GTIM2 — GTIM2 global interrupt
30 GTIM3 — GTIM3 global interrupt
31 I2C1 — I2C1 global interrupt
32 USART4 — USART4 global interrupt
33 I2C2 — I2C2 global interrupt
34 CAN — CAN global interrupt
35 SPI1 (SPI1_I2S) — SPI1 global interrupt
36 SPI2 — SPI2 global interrupt
37 USART1 — USART1 global interrupt
38 USART2 — USART2 global interrupt
39 USART3 — USART3 global interrupt
40 EXTI15_10 (EXTI) — EXTI Line 15 to 10 interrupt
41 RTC_Alarm (RTC) — RTC alarm interrupt
42 GTIM4 — GTIM4 global interrupt
43 ATIM2_BRK (ATIM2) — ATIM2 break interrupt
44 ATIM2_UP (ATIM2) — ATIM2 update interrupt
45 ATIM2_TRG_COM (ATIM2) — ATIM2 trigger and commutation interrupt
46 ATIM2_CC (ATIM2) — ATIM2 capture compare interrupt
