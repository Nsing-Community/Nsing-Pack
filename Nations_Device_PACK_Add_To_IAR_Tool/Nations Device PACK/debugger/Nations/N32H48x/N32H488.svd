# N32H488 register map
Vendor: Nationstech Ltd.; File version: 1.0
Registers are 32-bit, read-write, reset 0x0 unless marked. A register's access mark holds for its fields unless they carry their own. Offsets are from the block's base; lines under a group give offsets from that group; [hi:lo] are bit positions; {n}, {i} and the like mark numbered series; 'fields as' and 'values as' point back to an identical list; <NAME> marks a mode.

## Memory map
0x40000000 PWR size 0x400
0x40000400 WWDG size 0x400 — window watchdog
0x40000800 RTC size 0x400 — Real time clock
0x40000C00 USART2 size 0x400
0x40001000 USART3 size 0x400
0x40001400 UART8 size 0x400
0x40001800 IWDG size 0x400 — Independent watchdog
0x40001C00 I2C1 size 0x400 — Inter integrated circuit
0x40002000 I2C2 size 0x400
0x40002400 SPI2 size 0x400
0x40002600 I2S2_EXT size 0x400 — Inter—IC Sound
0x40002800 SPI3 size 0x400
0x40002A00 I2S3_EXT size 0x400
0x40002C00 GTIM1 size 0x400 — General purpose timer 1
0x40003000 GTIM2 size 0x400 — General purpose timer 2
0x40003400 GTIM3 size 0x400 — General purpose timer 3
0x40003800 GTIM4 size 0x400 — General purpose timer4
0x40003C00 BTIM1 size 0x400 — Basic timer
0x40004000 BTIM2 size 0x400 — Basic timer
0x40004800 USB_FS size 0x400 — Universal serial bus full-speed device interface
0x40005000 FDCAN1 size 0x400 — Flexible Datarate Controller Area Network
0x40005400 FDCAN2 size 0x400
0x40005800 FDCAN3 size 0x400
0x40005C00 GTIM5 size 0x400 — General purpose timer 5
0x40006000 GTIM6 size 0x400 — General purpose timer 6
0x40006400 GTIM7 size 0x400 — General purpose timer 7
0x40006800 UART5 size 0x400
0x40006C00 LPTIM1 size 0x400
0x40007000 LPTIM2 size 0x400
0x40007400 I2C3 size 0x400
0x40007800 I2C4 size 0x400
0x40007C00 DAC12 size 0x400
0x40008000 DAC34 size 0x400
0x40008400 DVP size 0x400 — Digital video port
0x40010400 EXTI size 0x1C — external interrupt/event controller
0x40010800 AFIO size 0x400 — Alternate function I/O
0x40010C00 GTIM8 size 0x400 — General purpose timer 8
0x40011000 GTIM9 size 0x400 — General purpose timer 9
0x40011400 GTIM10 size 0x400 — General purpose timer 10
0x40011800 SPI1 size 0x400 — Serial peripheral interface
0x40011C00 USART1 size 0x400
0x40012000 UART6 size 0x400
0x40012400 UART7 size 0x400
0x40012800 USART4 size 0x400
0x40012C00 SPI4 size 0x400
0x40013000 SPI5 size 0x400
0x40013400 SPI6 size 0x400
0x40013800 COMP size 0x400
0x40013C00 PGA size 0x400
0x40020000 DMA1 size 0x400 — Direct memory access controller
0x40020400 DMA2 size 0x400
0x40021000 RCC size 0x400
0x40021400 SDIO size 0x400
0x40021800 CRC size 0x400 — cyclic redundancy check
0x40021C00 FMAC size 0x400 — Filter math accelerator
0x40022000 FLASH size 0x400
0x40022400 CORDIC size 0x400
0x40025000 ETH size 0x2000
0x4002A800 DAC56 size 0x400
0x4002AC00 DAC78 size 0x400
0x4002B000 ADC1 size 0x400
0x4002B400 ADC2 size 0x400
0x4002B800 ADC3 size 0x400
0x4002BC00 ADC4 size 0x400
0x4002C000 GPIOA size 0x400 — General purpose I/O
0x4002C400 GPIOB size 0x400
0x4002C800 GPIOC size 0x400
0x4002CC00 GPIOD size 0x400
0x4002D000 GPIOE size 0x400
0x4002D400 GPIOF size 0x400
0x4002D800 GPIOG size 0x400
0x4002DC00 GPIOH size 0x400 — General purpose I/O
0x40030000 SHRTIM_Master size 0x400 — Super high resolution timer: Master Timers
0x40030080 SHRTIM_TIMA size 0x400 — Super high resolution timer: TIMA
0x40030100 SHRTIM_TIMB size 0x400 — Super high resolution timer: TIMB
0x40030180 SHRTIM_TIMC size 0x400 — Super high resolution timer: TIMC
0x40030200 SHRTIM_TIMD size 0x400 — Super high resolution timer: TIMD
0x40030280 SHRTIM_TIME size 0x400 — Super high resolution timer: TIME
0x40030300 SHRTIM_TIMF size 0x400 — Super high resolution timer: TIMF
0x40030380 SHRTIM_Common size 0x400 — Super high resolution timer: Common functions
0x40032000 ATIM1 size 0x400 — Advanced timer
0x40032400 ATIM2 size 0x400 — Advanced timer
0x40032800 ATIM3 size 0x400 — Advanced timer
0x40040000 USB_HS size 0x400 — USB high speed dual role
0x40040400 USB_HS_HOST size 0x400 — USB high speed host mode
0x40040800 USB_HS_DEVICE size 0x800 — USB high speed device mode
0x40040E00 USB_HS_PWRCLK size 0x400 — USB high speed PWR clock control
0xA0001000 xSPI size 0x400 — Multi-line SPI
0xA0002000 FEMC size 0x400 — Flexible external memory controller
0xE0042000 DBG size 0x400 — debug support for MCU

## Interrupts
0 WWDG — WWDG interrupt
1 PWR — PWR global interrupt
2 RTC_TAMPER_STAMP (RTC) — RTC Tamper interrupt or Timestamp through EXTI line 19
3 RTC_WKUP (RTC) — RTC wakeup timer through EXTI line 20 interrupt
4 FLASH — FLASH global interrupt
5 RCC — RCC global interrupt
6 EXTI0 (EXTI) — EXTI0 interrupt
7 EXTI1 (EXTI) — EXTI1 interrupt
8 EXTI2 (EXTI) — EXTI2 interrupt
9 EXTI3 (EXTI) — EXTI3 interrupt
10 EXTI4 (EXTI) — EXTI4 interrupt
11 DMA1_Channel1 (DMA1) — DMA1 channel1 global interrupt
12 DMA1_Channel2 (DMA1) — DMA1 channel2 global interrupt
13 DMA1_Channel3 (DMA1) — DMA1 channel3 global interrupt
14 DMA1_Channel4 (DMA1) — DMA1 channel4 global interrupt
15 DMA1_Channel5 (DMA1) — DMA1 channel5 global interrupt
16 DMA1_Channel6 (DMA1) — DMA1 channel6 global interrupt
17 DMA1_Channel7 (DMA1) — DMA1 channel7 global interrupt
18 ADC1_2 (ADC1, ADC2) — ADC1_2 global interrupt
19 USB_FS_HP (USB_FS) — USBFS Device HP interrupt
20 USB_FS_LP (USB_FS) — USBFS Device LP interrupt
21 FDCAN1_INT0 (FDCAN1) — FDCAN1 interrupt line 0
22 FDCAN1_INT1 (FDCAN1) — FDCAN1 interrupt line 1
23 EXTI9_5 (EXTI) — EXTI5/6/7/8/9 interrupt
24 ATIM1_BRK (ATIM1) — ATIM1 break interrupt
25 ATIM1_UP (ATIM1) — ATIM1 update interrupt
26 ATIM1_TRG_COM (ATIM1) — ATIM1 trigger and commutation Interrupt
27 ATIM1_CC (ATIM1) — ATIM1 capture compare interrupt
28 GTIM1 — GTIM1 global interrupt
29 GTIM2 — GTIM2 global interrupt
30 GTIM3 — GTIM3 global interrupt
31 I2C1_EV (I2C1) — I2C1 Event interrupt
32 I2C1_ER (I2C1) — I2C1 Error interrupt
33 I2C2_EV (I2C2) — I2C2 Event interrupt
34 I2C2_ER (I2C2) — I2C2 Error interrupt
35 SPI1 — SPI1 global interrupt
36 SPI2 (SPI2, I2S2_EXT) — SPI2/I2S2/I2S2_EXT global interrupt
37 USART1 — USART1 global interrupt
38 USART2 — USART2 global interrupt
39 USART3 — USART3 global interrupt
40 EXTI15_10 (EXTI) — EXTI10/11/12/13/14/15 interrupt
41 RTC_Alarm (RTC) — RTC Alarm through EXTI Line 17 Interrupt
42 USB_FS_WakeUp (USB_FS) — USB Device WakeUp from suspend through EXTI Line Interrupt
43 ATIM2_BRK (ATIM2) — ATIM2 break interrupt
44 ATIM2_UP (ATIM2) — ATIM2 update interrupt
45 ATIM2_TRG_COM (ATIM2) — ATIM2 trigger and commutation Interrupt
46 ATIM2_CC (ATIM2) — ATIM2 capture compare interrupt
47 ADC3_4 (ADC3, ADC4) — ADC3_4 global interrupt
49 SDIO — SDIO global interrupt
50 GTIM4 — GTIM4 global interrupt
51 SPI3 (SPI3, I2S3_EXT) — SPI3/I2S3/I2S3_EXT global interrupt
52 USART4 — USART4 global interrupt
53 UART5 — UART5 global interrupt
54 BTIM1 — BTIM1 global interrupt
55 BTIM2 — BTIM2 global interrupt
56 DMA2_Channel1 (DMA2) — DMA2 Channel global interrupt
57 DMA2_Channel2 (DMA2) — DMA2 channel2 global interrupt
58 DMA2_Channel3 (DMA2) — DMA2 channel3 global interrupt
59 DMA2_Channel4 (DMA2) — DMA2 channel4 global interrupt
60 DMA2_Channel5 (DMA2) — DMA2 channel5 global interrupt
62 COMP4_5_6 (COMP) — COMP4_5_6 global interrupt
63 FDCAN2_INT0 (FDCAN2) — FDCAN2 interrupt line 0
64 FDCAN2_INT1 (FDCAN2) — FDCAN2 interrupt line 1
65 FDCAN3_INT0 (FDCAN3) — FDCAN3 interrupt line 0
66 FDCAN3_INT1 (FDCAN3) — FDCAN3 interrupt line 1
67 xSPI — xSPI global interrupt
68 DMA2_Channel6 (DMA2) — DMA2 channel6 global interrupt
69 DMA2_Channel7 (DMA2) — DMA2 channel7 global interrupt
70 I2C3_EV (I2C3) — I2C3 Event interrupt
71 I2C3_ER (I2C3) — I2C3 Error interrupt
72 I2C4_EV (I2C4) — I2C4 Event interrupt
73 I2C4_ER (I2C4) — I2C4 Error interrupt
74 UART6 — UART6 global interrupt
75 UART7 — UART7 global interrupt
76 DMA1_Channel8 (DMA1) — DMA1 channel8 global interrupt
77 DMA2_Channel8 (DMA2) — DMA2 channel8 global interrupt
78 DVP — DVP global interrupt
81 COMP1_2_3 (COMP) — COMP1_2_3 global interrupt
82 USB_HS_EPx_OUT (USB_HS) — USB_HS out EP global interrupt
83 USB_HS_EPx_IN (USB_HS) — USB_HS in EP global interrupt
84 USB_HS_WKUP (USB_HS) — USB_HS wakeup
85 UART8 — UART8 global interrupt
86 SPI4 — SPI4 global interrupt
87 ETH — ETH global interrupt
88 ETH_WKUP (ETH) — ETH wakeup through EXTI Line 27 interrupt
89 GTIM5 — GTIM5 global interrupt
90 COMP7 (COMP) — COMP7 global interrupt
91 SHRTIM_Master — SHRTIM_Master global interrupt
92 SHRTIM_TIMA — SHRTIM_TIMA global interrupt
93 SHRTIM_TIMB — SHRTIM_TIMB global interrupt
94 SHRTIM_TIMC — SHRTIM_TIMC global interrupt
95 SHRTIM_TIMD — SHRTIM_TIMD global interrupt
96 SHRTIM_TIME — SHRTIM_TIME global interrupt
97 SHRTIM_TIMF — SHRTIM_TIMF global interrupt
98 SHRTIM_Common — SHRTIM_Common global interrupt
99 ATIM3_BRK (ATIM3) — ATIM3 break interrupt
100 ATIM3_UP (ATIM3) — ATIM3 update interrupt
101 ATIM3_TRG_COM (ATIM3) — ATIM3 trigger and commutation Interrupt
102 ATIM3_CC (ATIM3) — ATIM3 capture compare interrupt
103 GTIM6 — GTIM6 global interrupt
104 LPTIM1_WKUP (LPTIM1) — LPTIM1 wakeup through EXTI Line 25 interrupt
105 LPTIM2_WKUP (LPTIM2) — LPTIM2 wakeup through EXTI Line 26 interrupt
106 FMAC — FMAC global interrupt
107 CORDIC — CORDIC global interrupt
108 SPI5 — SPI5 global interrupt
109 SPI6 — SPI6 global interrupt
110 GTIM7 — GTIM7 global interrupt
111 GTIM8 — GTIM8 global interrupt
112 GTIM9 — GTIM9 global interrupt
113 GTIM10 — GTIM10 global interrupt
114 DAC1234 (DAC12, DAC34) — DAC1234 global interrupt
115 DAC5678 (DAC56, DAC78) — DAC5678 global interrupt
116 USB_HS — USB_HS global interrupt
117 FEMC — FEMC global interrupt
